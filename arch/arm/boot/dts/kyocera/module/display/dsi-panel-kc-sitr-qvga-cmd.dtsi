/*
 * This software is contributed or developed by KYOCERA Corporation.
 * (C) 2017 KYOCERA Corporation
 * (C) 2015 KYOCERA Corporation
 */
/* Copyright (c) 2013-2014, The Linux Foundation. All rights reserved.
 *
 * This program is free software; you can redistribute it and/or modify
 * it under the terms of the GNU General Public License version 2 and
 * only version 2 as published by the Free Software Foundation.
 *
 * This program is distributed in the hope that it will be useful,
 * but WITHOUT ANY WARRANTY; without even the implied warranty of
 * MERCHANTABILITY or FITNESS FOR A PARTICULAR PURPOSE.  See the
 * GNU General Public License for more details.
 */

/*---------------------------------------------------------------------------
 * This file is autogenerated file using gcdb parser. Please do not edit it.
 * Update input XML file to add a new entry or update variable in this file
 * VERSION = "1.0"
 *---------------------------------------------------------------------------*/
&mdss_mdp {
	dsi_kc_sitr_qvga_vid: qcom,mdss_dsi_kc_sitr_qvga_cmd {
		qcom,mdss-dsi-panel-name = "kc_sitr qvga cmd mode dsi panel";
		qcom,mdss-dsi-panel-controller = <&mdss_dsi0>;
/*		qcom,mdss-dsi-panel-type = "dsi_video_mode";*/
		qcom,mdss-dsi-panel-type = "dsi_cmd_mode";
		qcom,mdss-dsi-panel-destination = "display_1";
		qcom,mdss-dsi-panel-framerate = <60>;
		qcom,mdss-dsi-panel-clockrate = <100000000>;
		qcom,mdss-dsi-virtual-channel-id = <0>;
		qcom,mdss-dsi-stream = <0>;
		qcom,mdss-dsi-panel-width = <240>;
		qcom,mdss-dsi-panel-height = <320>;
		qcom,mdss-dsi-h-front-porch = <10>;
		qcom,mdss-dsi-h-back-porch = <20>;
		qcom,mdss-dsi-h-pulse-width = <10>;
		qcom,mdss-dsi-h-sync-skew = <0>;
		qcom,mdss-dsi-v-back-porch = <2>;
		qcom,mdss-dsi-v-front-porch = <4>;
		qcom,mdss-dsi-v-pulse-width = <2>;
		qcom,mdss-dsi-h-left-border = <0>;
		qcom,mdss-dsi-h-right-border = <0>;
		qcom,mdss-dsi-v-top-border = <0>;
		qcom,mdss-dsi-v-bottom-border = <0>;
		qcom,mdss-dsi-bpp = <16>;
		qcom,mdss-dsi-underflow-color = <0xff>;
		qcom,mdss-dsi-border-color = <0>;
		qcom,mdss-dsi-on-command = [
				29 01 00 00 01 00 06 10 02 07 00 00 00
				29 01 00 00 01 00 06 64 01 02 00 00 00
				29 01 00 00 01 00 06 68 01 02 00 00 00
				29 01 00 00 01 00 06 44 01 00 00 00 00
				29 01 00 00 01 00 06 48 01 00 00 00 00
				29 01 00 00 01 00 06 14 01 04 00 00 00
				29 01 00 00 01 00 06 50 04 63 00 00 00
				29 01 00 00 01 00 06 54 04 21 01 00 00
				29 01 00 00 01 00 06 14 04 05 00 00 00
				29 01 00 00 01 00 06 00 04 01 00 00 00
				29 01 00 00 01 00 06 10 04 07 00 00 00
				29 01 00 00 01 00 06 18 04 2C 00 00 00
				29 01 00 00 01 00 06 40 04 10 01 00 00
				29 01 00 00 01 00 06 64 04 05 04 00 00
				29 01 00 00 01 00 06 04 01 01 00 00 00
				29 01 00 00 01 00 06 04 02 01 00 00 00
				29 01 00 00 01 00 06 68 04 04 00 00 00
				29 01 00 00 05 00 06 70 04 00 00 66 9C
					];

		kc,mdss-dsi-on-post-command = [
				29 01 00 00 96 00 03 00 05 11
				29 01 00 00 01 00 04 00 05 36 00
				29 01 00 00 01 00 04 00 05 3A 05
				29 01 00 00 01 00 08 00 05 B2 0C 0C 00 33 33
				29 01 00 00 01 00 04 00 05 B7 35
				29 01 00 00 01 00 04 00 05 BB 1A
				29 01 00 00 01 00 04 00 05 C0 2C
				29 01 00 00 01 00 04 00 05 C2 01
				29 01 00 00 01 00 04 00 05 C3 11
				29 01 00 00 01 00 04 00 05 C4 20
				29 01 00 00 01 00 04 00 05 C6 0F
				29 01 00 00 01 00 05 00 05 D0 A4 A1
				29 01 00 00 01 00 11 00 05 E0 D0 00 06 0D 0F 2A 39 44 49 0B 16 15 1A 1D
				29 01 00 00 01 00 11 00 05 E1 D0 00 06 0D 0F 2A 37 44 49 0B 17 15 1B 1E
				29 01 00 00 01 00 04 00 05 35 00 /* TE */
				29 01 00 00 10 00 03 00 05 29
				29 01 00 00 01 00 07 00 05 2A 00 00 00 EF
				29 01 00 00 10 00 07 00 05 2B 00 00 01 3F
				29 01 00 00 01 00 06 14 04 05 00 00 00
					];

		kc,mdss-dsi-on-post-command1 = [
				//29 01 00 00 00 00 03 00 05 29
					];

		kc,mdss-dsi-on-post-command2 = [
				//29 01 00 00 00 00 03 00 05 29
					];

		qcom,mdss-dsi-off-command = [
				29 01 00 00 1E 00 03 00 05 28
				29 01 00 00 01 00 03 00 05 10
					];

		qcom,mdss-dsi-on-command-state = "dsi_lp_mode";
		kc,mdss-dsi-on-post-command-state = "dsi_lp_mode";                /* dummy */
		kc,mdss-dsi-on-post-command-state2 = "dsi_hs_mode";
		qcom,mdss-dsi-off-command-state = "dsi_hs_mode";
		qcom,mdss-dsi-h-sync-pulse = <1>;
		qcom,mdss-dsi-traffic-mode = "non_burst_sync_event";
		qcom,mdss-dsi-bllp-eof-power-mode;
		qcom,mdss-dsi-bllp-power-mode;
		qcom,mdss-dsi-lane-0-state;
		qcom,mdss-dsi-lane-1-state;
		qcom,mdss-dsi-panel-timings = [56 06 02 00 20 4A 08 0A 08 03 04 00];
		qcom,mdss-dsi-t-clk-post = <0x06>;
		qcom,mdss-dsi-t-clk-pre = <0x12>;
		qcom,mdss-dsi-dma-trigger = "trigger_sw";
		qcom,mdss-dsi-mdp-trigger = "none";
		qcom,mdss-dsi-tx-eot-append;
/*		qcom,mdss-dsi-te-pin-select = <0>;*/

		qcom,mdss-dsi-te-pin-select = <1>;
		qcom,mdss-dsi-wr-mem-start = <0x2c>;
		qcom,mdss-dsi-wr-mem-continue = <0x3c>;
		qcom,mdss-dsi-te-dcs-command = <1>;
		qcom,mdss-dsi-te-check-enable;
		qcom,mdss-dsi-te-using-te-pin;

		qcom,mdss-dsi-bl-min-level = <1>;
		qcom,mdss-dsi-bl-max-level = <4095>;
//		qcom,mdss-dsi-bl-pmic-control-type = "bl_ctrl_wled";
		qcom,mdss-dsi-reset-sequence = <1 10>, <0 10>, <1 10>;
		qcom,mdss-pan-physical-width-dimension = <39>;
		qcom,mdss-pan-physical-height-dimension = <52>;
		qcom,mdss-dsi-post-init-delay = <2>;

		kc,panel-mipiic-enabled;

		kc,dma-p-csc-mv = <
			0x0050
			0x009e
			0x001f
			0x007b
			0x00f2
			0x002f
			0x0099
			0x012d
			0x003a
		>;
		kc,dma-p-csc-pre-bv = <
			0x0000
			0x0000
			0x0000
		>;
		kc,dma-p-csc-post-bv = <
			0x0000
			0x0000
			0x0000
		>;
		kc,dma-p-csc-pre-lv = <
			0x0000
			0x00ff
			0x0000
			0x00ff
			0x0000
			0x00ff
		>;
		kc,dma-p-csc-post-lv = <
			0x0000
			0x00ff
			0x0000
			0x00ff
			0x0000
			0x00ff
		>;
	};
};
