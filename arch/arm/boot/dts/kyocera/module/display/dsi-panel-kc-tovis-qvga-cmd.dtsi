/*
 * This software is contributed or developed by KYOCERA Corporation.
 * (C) 2018 KYOCERA Corporation
 */
/* Copyright (c) 2013-2014, The Linux Foundation. All rights reserved.
 *
 * This program is free software; you can redistribute it and/or modify
 * it under the terms of the GNU General Public License version 2 and
 * only version 2 as published by the Free Software Foundation.
 *
 * This program is distributed in the hope that it will be useful,
 * but WITHOUT ANY WARRANTY; without even the implied warranty of
 * MERCHANTABILITY or FITNESS FOR A PARTICULAR PURPOSE.  See the
 * GNU General Public License for more details.
 */

/*---------------------------------------------------------------------------
 * This file is autogenerated file using gcdb parser. Please do not edit it.
 * Update input XML file to add a new entry or update variable in this file
 * VERSION = "1.0"
 *---------------------------------------------------------------------------*/
&mdss_mdp {
	dsi_kc_tovis_qvga_vid: qcom,mdss_dsi_kc_tovis_qvga_cmd {
		qcom,mdss-dsi-panel-name = "kc_tovis qvga cmd mode dsi panel";
		qcom,mdss-dsi-panel-controller = <&mdss_dsi0>;
		qcom,mdss-dsi-panel-type = "dsi_cmd_mode";
		qcom,mdss-dsi-panel-destination = "display_1";
		qcom,mdss-dsi-panel-framerate = <76>;
		qcom,mdss-dsi-virtual-channel-id = <0>;
		qcom,mdss-dsi-stream = <0>;
		qcom,mdss-dsi-panel-width = <240>;
		qcom,mdss-dsi-panel-height = <320>;
		qcom,mdss-dsi-h-front-porch = <52>;
		qcom,mdss-dsi-h-back-porch = <56>;
		qcom,mdss-dsi-h-pulse-width = <4>;
		qcom,mdss-dsi-h-sync-skew = <0>;
		qcom,mdss-dsi-v-back-porch = <10>;
		qcom,mdss-dsi-v-front-porch = <12>;
		qcom,mdss-dsi-v-pulse-width = <2>;
		qcom,mdss-dsi-h-left-border = <0>;
		qcom,mdss-dsi-h-right-border = <0>;
		qcom,mdss-dsi-v-top-border = <0>;
		qcom,mdss-dsi-v-bottom-border = <0>;
		qcom,mdss-dsi-bpp = <24>;
		qcom,mdss-dsi-underflow-color = <0xff>;
		qcom,mdss-dsi-border-color = <0>;
		qcom,mdss-dsi-on-command = [
				29 01 00 00 01 00 06 10 02 07 00 00 00
				29 01 00 00 01 00 06 64 01 0A 00 00 00
				29 01 00 00 01 00 06 68 01 0A 00 00 00
				29 01 00 00 01 00 06 44 01 00 00 00 00
				29 01 00 00 01 00 06 48 01 00 00 00 00
				29 01 00 00 01 00 06 14 01 02 00 00 00
				29 01 00 00 01 00 06 50 04 01 00 00 00
				29 01 00 00 01 00 06 54 04 22 01 00 00
				29 01 00 00 01 00 06 00 04 01 00 00 00
				29 01 00 00 01 00 06 10 04 07 00 00 00
				29 01 00 00 01 00 06 18 04 3C 00 00 00
				29 01 00 00 01 00 06 40 04 18 01 00 00
				29 01 00 00 01 00 06 64 04 05 04 00 00
				29 01 00 00 01 00 06 04 01 01 00 00 00
				29 01 00 00 01 00 06 04 02 01 00 00 00
				29 01 00 00 01 00 06 68 04 04 00 00 00
				29 01 00 00 05 00 06 70 04 00 00 28 44
					];

		kc,mdss-dsi-on-post-command = [
				29 01 00 00 01 00 04 00 05 C0 21
				29 01 00 00 01 00 04 00 05 C1 10
				29 01 00 00 01 00 05 00 05 C5 2A 3F
				29 01 00 00 01 00 08 00 05 CB 39 2C 00 34 02
				29 01 00 00 01 00 06 00 05 CF 00 A9 30
				29 01 00 00 01 00 05 00 05 EA 00 00
				29 01 00 00 01 00 07 00 05 ED 64 03 12 81
				29 01 00 00 01 00 04 00 05 F7 20
				29 01 00 00 01 00 03 00 05 13
				29 01 00 00 01 00 04 00 05 36 98
				29 01 00 00 01 00 04 00 05 3A 06
				29 01 00 00 01 00 05 00 05 B1 00 19
				29 01 00 00 01 00 04 00 05 B4 00
				29 01 00 00 01 00 07 00 05 B5 08 08 08 08
				29 01 00 00 01 00 07 00 05 B6 0A 02 27 00
				29 01 00 00 01 00 04 00 05 35 00
				29 01 00 00 01 00 05 00 05 44 00 EF
				29 01 00 00 01 00 12 00 05 E0 0D 34 30 0B 0D 05 52 75 3E 04 0F 03 17 11 00
				29 01 00 00 01 00 12 00 05 E1 08 0E 12 03 10 05 2F 44 45 05 0C 09 28 2F 0F
				29 01 00 00 01 00 07 00 05 2A 00 00 00 EF
				29 01 00 00 01 00 07 00 05 2B 00 00 01 3F
				29 01 00 00 01 00 06 00 05 E8 85 01 78
				29 01 00 00 50 00 03 00 05 11
				29 01 00 00 01 00 06 14 04 06 00 00 00
					];

		kc,mdss-dsi-on-post-command2 = [
				29 01 00 00 00 00 03 00 05 29
					];

		qcom,mdss-dsi-off-command = [
				29 01 00 00 19 00 03 00 05 28
				29 01 00 00 78 00 03 00 05 10
					];

		qcom,mdss-dsi-on-command-state = "dsi_lp_mode";
		kc,mdss-dsi-on-post-command-state = "dsi_lp_mode";                /* dummy */
		kc,mdss-dsi-on-post-command-state2 = "dsi_hs_mode";
		qcom,mdss-dsi-off-command-state = "dsi_hs_mode";
		qcom,mdss-dsi-h-sync-pulse = <1>;
		qcom,mdss-dsi-traffic-mode = "non_burst_sync_event";
		qcom,mdss-dsi-bllp-eof-power-mode;
		qcom,mdss-dsi-bllp-power-mode;
		qcom,mdss-dsi-lane-0-state;
		qcom,mdss-dsi-lane-1-state;
		qcom,mdss-dsi-panel-timings = [37 0A 04 00 22 24 08 1E 05 03 04 00];
		qcom,mdss-dsi-t-clk-post = <0x05>;
		qcom,mdss-dsi-t-clk-pre = <0x0F>;
		qcom,mdss-dsi-dma-trigger = "trigger_sw";
		qcom,mdss-dsi-mdp-trigger = "none";
		qcom,mdss-dsi-tx-eot-append;
		qcom,mdss-dsi-post-init-delay = <3>;

		qcom,mdss-dsi-te-pin-select = <1>;
		qcom,mdss-dsi-wr-mem-start = <0x2c>;
		qcom,mdss-dsi-wr-mem-continue = <0x3c>;
		qcom,mdss-dsi-te-dcs-command = <1>;
		qcom,mdss-dsi-te-check-enable;
		qcom,mdss-dsi-te-using-te-pin;

		qcom,mdss-dsi-bl-min-level = <1>;
		qcom,mdss-dsi-bl-max-level = <4095>;
//		qcom,mdss-dsi-bl-pmic-control-type = "bl_ctrl_wled";
		qcom,mdss-dsi-reset-sequence = <1 10>, <0 10>, <1 120>;
		qcom,mdss-pan-physical-width-dimension = <43>;
		qcom,mdss-pan-physical-height-dimension = <58>;

//		kc,panel-detect-enabled;
		kc,panel-mipiic-enabled;
	};
};
