## drivers/nfc/Kconfig
```kconfig
#
# drivers/nfc/Kconfig
#
# This software is contributed or developed by KYOCERA Corporation.
# (C) 2014 KYOCERA Corporation
# (C) 2015 KYOCERA Corporation
# (C) 2016 KYOCERA Corporation
#

#
# Near Field Communication (NFC) devices
#

menu "Near Field Communication (NFC) devices"
	depends on NFC

config NFC_PN533
	tristate "NXP PN533 USB driver"
	depends on USB
	help
	  NXP PN533 USB driver.
	  This driver provides support for NFC NXP PN533 devices.

	  Say Y here to compile support for PN533 devices into the
	  kernel or say M to compile it as module (pn533).

config NFC_WILINK
	tristate "Texas Instruments NFC WiLink driver"
	depends on TI_ST && NFC_NCI
	help
	  This enables the NFC driver for Texas Instrument's BT/FM/GPS/NFC
	  combo devices. This makes use of shared transport line discipline
	  core driver to communicate with the NFC core of the combo chip.

	  Say Y here to compile support for Texas Instrument's NFC WiLink driver
	  into the kernel or say M to compile it as module.

config NFC_MEI_PHY
	tristate "MEI bus NFC device support"
	depends on INTEL_MEI && NFC_HCI
	help
	  This adds support to use an mei bus nfc device. Select this if you
	  will use an HCI NFC driver for an NFC chip connected behind an
	  Intel's Management Engine chip.

	  If unsure, say N.

source "drivers/nfc/pn544/Kconfig"
source "drivers/nfc/microread/Kconfig"

endmenu

config NFC_QNCI
	bool "Qualcomm NCI based NFC Controller Driver for qca199x"
	depends on I2C
	select CRC_CCITT
	help
	  This enables the NFC driver for QCA199x based devices.
	  This is for i2c connected version. NCI protocol logic
	  resides in the usermode and it has no other NFC dependencies.

config NFC_NQ
	bool "Qualcomm NCI based NFC Controller Driver for NQx"
	depends on I2C
	select CRC_CCITT
	help
	  This enables the NFC driver for NQx based devices.
	  This is for i2c connected version. NCI protocol logic
	  resides in the usermode and it has no other NFC dependencies.


menuconfig NFC_DEVICES
	bool "Near Field Communication (NFC) devices"
	default n
	---help---
	  You'll have to say Y if your computer contains an NFC device that
	  you want to use under Linux.

	  You can say N here if you don't have any Near Field Communication
	  devices connected to your computer.

if NFC_DEVICES

config CXD224X_NFC
	tristate "CXD224X NFC driver"
	depends on I2C
	select CRC_CCITT
	default n
	---help---
	  Say yes if you want cxd224x Near Field Communication driver.
	  This is for i2c connected version. If unsure, say N here.

	  To compile this driver as a module, choose m here. The module will
	  be called cxd224x-i2c.

config CXD224X_NFC_VEN
	tristate "CXD224X NFC VEN"
	depends on CXD224X_NFC
	default n
	---help---
	  Say yes if you want to use cxd224x NFC VEN(enable voltage) control.
	  If unsure, say N here.

config CXD224X_NFC_RST
	tristate "CXD224X NFC RST"
	depends on CXD224X_NFC
	default y
	---help---
	  Say yes if you want to use cxd224x NFC RST(external XRST pin) control.

endif # NFC_DEVICES
```

## drivers/sensors/Kconfig
```kconfig
#
# This software is contributed or developed by KYOCERA Corporation.
# (C) 2015 KYOCERA Corporation
# (C) 2016 KYOCERA Corporation
# (C) 2019 KYOCERA Corporation
#

config INPUT_SENSOR_PROXIMITY
	tristate "Proximity/Light Sensor Driver"
	default n
	help
		Support Proximity/Light Sensor Driver.

config INPUT_ALPS_INPUT
        tristate "Input device driver for alps sensor"
	default y

config INPUT_HSCDTD
        tristate "GeoMagneticField device driver for I2C"
	default n

config INPUT_SENSOR_ACCELEROMETER
        tristate "Accelerometer device driver for I2C"
	default y

config INPUT_SENSOR_ACC_U2DH
		tristate "Accelerometer device U2DH driver"
	default y
	help
		This option enables U2DH Accelerometer Sensor driver.
		U2DH is made by Invensence.

config INPUT_SENSOR_ACC_MXC400XXC
		tristate "Accelerometer device MXC400xXC driver"
	default n
	help
		This option enables MXC400xXC Accelerometer Sensor driver.
		MXC400xXC is made by MEMSIC.

config SENSORS
	bool "Sensors Class Support"
	default n
	help
	  This option enables the sensor sysfs class in /sys/class/sensors.
	  You'll need this to do anything useful with sensorss. If unsure, say N.

config SENSORS_SSC
	bool "Enable Sensors Driver Support for SSC"
	default n
	help
	  Add support for sensors SSC driver.
	  This driver is used for exercising sensors use case,
	  time syncing with ADSP clock.

config KC_COLOR_VARIATION
	tristate "Color Variation"
	default n
	help
		Support Color Variation.
```

## drivers/video/msm/mdss/Kconfig
```kconfig
# This software is contributed or developed by KYOCERA Corporation.
# (C) 2016 KYOCERA Corporation

config FB_MSM_MDSS_WRITEBACK
	bool "MDSS Writeback Panel"
	---help---
	The MDSS Writeback Panel provides support for routing the output of
	MDSS frame buffer driver and MDP processing to memory.

config FB_MSM_MDSS_HDMI_PANEL
	depends on FB_MSM_MDSS
	bool "MDSS HDMI Tx Panel"
	default n
	---help---
	The MDSS HDMI Panel provides support for transmitting TMDS signals of
	MDSS frame buffer data to connected hdmi compliant TVs, monitors etc.

config FB_MSM_MDSS_HDMI_MHL_SII8334
	depends on FB_MSM_MDSS_HDMI_PANEL
	bool 'MHL SII8334 support '
	default n
	---help---
	  Support the HDMI to MHL conversion.
	  MHL (Mobile High-Definition Link) technology
	  uses USB connector to output HDMI content

config FB_MSM_MDSS_DSI_CTRL_STATUS
	tristate "DSI controller status check feature"
	---help---
	  Check DSI controller status periodically (default period is 5
	  seconds) by sending Bus-Turn-Around (BTA) command. If DSI controller
	  fails to acknowledge the BTA command, it sends PANEL_ALIVE=0 status
	  to HAL layer to reset the controller.

config FB_MSM_MDSS_EDP_PANEL
	depends on FB_MSM_MDSS
	bool "MDSS eDP Panel"
	---help---
	The MDSS eDP Panel provides support for eDP host controller driver
	which runs in Video mode only and is responsible for transmitting
	frame buffer from host SOC to eDP display panel.

config FB_MSM_MDSS_MDP3
	depends on FB_MSM_MDSS
	bool "MDP3 display controller"
	---help---
	The MDP3 provides support for an older version display controller
	included in latest display sub-system, known as MDSS.

config DISP_EXT_UTIL
	bool "To enable the display utility"
	default y
	---help---
	  Say Y here if you want to enable the utility of your display.
config DISP_EXT_DIAG
	bool "To enable the display diag function"
	default y
	---help---
	  Say Y here if you want to enable the diag function of your display.
config DISP_EXT_BOARD
	bool "Enables the detection function of the display board"
	default y
	---help---
	  Say Y here if you want to enable the detection function of your display.
config DISP_EXT_PROPERTY
	bool "To enable the display property function"
	default y
	---help---
	  Say Y here if you want to enable the property function of your display.
config DISP_EXT_PP
	bool "Enables display color adjustment post processing"
	default y
	---help---
	  Say Y here if you want to enable display color adjustment post processing.

config DISP_EXT_SUB
	bool "To enable the sub display"
	default y
	---help---
	  Say Y here if you want to enable the sub display.
config DISP_EXT_I2C
	bool "To enable the i2c"
	default y
	---help---
	  Say Y here if you want to enable the i2c.
```

## security/misc/Kconfig
```kconfig
#
# This software is contributed or developed by KYOCERA Corporation.
# (C) 2014 KYOCERA Corporation
# (C) 2015 KYOCERA Corporation
#
# Security misc configuration
#

config SECURITY_KCPDSM
	bool "Enable Kyocera PiD-based Security Module"
	default n
	depends on SECURITY
	help
	  If enabled, kernel supports kcpdsm.
	  If you are unsure how to answer this question, answer N.
```
